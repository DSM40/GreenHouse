
#define __DEBUG__
#include <ESP8266WiFi.h>
 #include "ThingSpeak.h"
#include "DHT.h"
#include <SPI.h>
#include <Wire.h>
#include <Adafruit_GFX.h>
#include <Adafruit_SSD1306.h>
#include "ccs811.h"  // CCS811 library
CCS811 ccs811; 
// para el AM2301A se usa DHT21
#define DHTTYPE DHT21 // DHT 11

const char* ssid="Lab_BioIngenieria";
const char* password = "Ecy5exh54rgg";   // contraseña de la red a conectarse

WiFiClient  client; // activamos el cliente Wifi
unsigned long myChannelNumber = "";  //ID del canal de ThingSpeak
const char * myWriteAPIKey = ""; //API key para escritura del navegador de ingSpeak
unsigned long myChannelNumber2 = "";
const char * myWriteAPIKey2 ="";
const char * myReadAPIKey2 = "";
uint8_t DHTPin = D6;
DHT dht(DHTPin, DHTTYPE);
int conteco=0;
float Temperature;
float Humidity;
unsigned long tiempo1 = 0;
unsigned long tiempo2 = 0;
unsigned long tiempoSegundos = 0;
 int contador=0;
 bool boton1;
 bool boton2;
 bool botonanterior1=HIGH;
 bool botonanterior2=LOW;
 float temperatura;
// Definir constantes
#define ANCHO_PANTALLA 128 // ancho pantalla OLED
#define ALTO_PANTALLA 64 // alto pantalla OLED
 
// Objeto de la clase Adafruit_SSD1306
Adafruit_SSD1306 display(ANCHO_PANTALLA, ALTO_PANTALLA, &Wire, -1);



static const unsigned char PROGMEM wifi[512] = {
0x00, 0x00, 0x00, 0x00, 0x00, 0x00, 0x00, 0x00, 
    0x00, 0x00, 0x00, 0x00, 0x00, 0x00, 0x00, 0x00, 
    0x00, 0x00, 0x00, 0x00, 0x00, 0x00, 0x00, 0x00, 
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    0x00, 0x00, 0x00, 0x00, 0x00, 0x00, 0x00, 0x00
    };
static const unsigned char PROGMEM nowifi[512] = {
    0x00, 0x00, 0x00, 0x00, 0x00, 0x00, 0x00, 0x00, 
    0x00, 0x00, 0x00, 0x00, 0x00, 0x00, 0x00, 0x00, 
    0x00, 0x00, 0x00, 0x00, 0x00, 0x00, 0x00, 0x00, 
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    0x00, 0x00, 0x00, 0x00, 0x00, 0x00, 0x00, 0x00
};
void setup() {
Wire.begin(); 
  
  // Enable CCS811
  ccs811.set_i2cdelay(50); // Needed for ESP8266 because it doesn't handle I2C clock stretch correctly
   bool ok= ccs811.begin();
  ok= ccs811.start(CCS811_MODE_1SEC);
   pinMode(DHTPin, INPUT);   
     dht.begin();             //Iniciamos el sensor
  WiFi.mode(WIFI_STA);// Usamos la tarjeta ESP como STATION 
  ThingSpeak.begin(client);  // Initializar ThingSpeak
  
      tiempo1 = millis();
  pinMode(D3, INPUT);
  pinMode(D5, INPUT);
  pinMode(D8, OUTPUT);
  pinMode(A0, OUTPUT);
#ifdef __DEBUG__
  Serial.begin(9600);
  delay(100);
  Serial.println("Iniciando pantalla OLED");
#endif
 
  // Iniciar pantalla OLED en la dirección 0x3C
  if (!display.begin(SSD1306_SWITCHCAPVCC, 0x3C)) {
#ifdef __DEBUG__
    Serial.println("No se encuentra la pantalla OLED");
#endif
    while (true);
  }
 
     display.clearDisplay();
     display.setTextSize(1);
     // Color del texto
     display.setTextColor(SSD1306_WHITE);
     // Posición del texto
     
      display.setCursor(5, 32);
      display.print("Iniciando...");
     
      display.display();
}
 int ctrl=0;
void loop() {
   boton1=digitalRead(D3);
   boton2=digitalRead(D5);
   temperatura=((analogRead(A0)*0.322265625));
   uint16_t eco2, etvoc, errstat, raw;
   
   

  /* Serial.print("CCS811: ");
    Serial.print("eco2=");  Serial.print(eco2);     Serial.print(" ppm  ");
    Serial.print("etvoc="); Serial.print(etvoc);    Serial.println(" ppb  ");*/
  //Serial.println(temperatura);
  //Serial.println(Temperature);
  //Serial.println(Humidity);
  //Serial.println(eco2);
  // Print measurement results based on status
  if( errstat==CCS811_ERRSTAT_OK ) { 
    //Serial.print("CCS811: ");
    //Serial.print("eco2=");  Serial.print(eco2);     Serial.print(" ppm  ");
    //Serial.print("etvoc="); Serial.print(etvoc);    Serial.print(" ppb  ");
    //Serial.print("raw6=");  Serial.print(raw/1024); Serial.print(" uA  "); 
    //Serial.print("raw10="); Serial.print(raw%1024); Serial.print(" ADC  ");
    //Serial.print("R="); Serial.print((1650*1000L/1023)*(raw%1024)/(raw/1024)); Serial.print(" ohm");
    //Serial.println();
  } /*else if( errstat==CCS811_ERRSTAT_OK_NODATA ) {
    Serial.println("CCS811: waiting for (new) data");
  } else if( errstat & CCS811_ERRSTAT_I2CFAIL ) { 
    Serial.println("CCS811: I2C error");
  } else {
    Serial.print("CCS811: errstat="); Serial.print(errstat,HEX); 
    Serial.print("="); Serial.println( ccs811.errstat_str(errstat) ); 
  }*/
   tiempo2 = millis(); 
   
    if(WiFi.status() != WL_CONNECTED){
      Serial.print("Intentando conectar...");
      while(WiFi.status() != WL_CONNECTED){
        
        WiFi.begin(ssid, password); 
        delay(5000);
        
        display.clearDisplay();
  // Tamaño del texto
     display.drawBitmap(32,0, nowifi, 64, 64, SSD1306_WHITE);
  // Enviar a pantalla
      display.display();
           
      } 
      Serial.println("\nConectado.");
      /* display.clearDisplay();
  // Tamaño del texto
     display.drawBitmap(32,0, wifi, 64, 64, SSD1306_WHITE);
  // Enviar a pantalla
      display.display();*/
    }

    else {
      
    }
  //Serial.println(digitalRead(D6));
  if (boton1==LOW && botonanterior1==HIGH){
    contador++;
   // Serial.println(contador);
  }
  botonanterior1=boton1;
  if (boton2==HIGH && botonanterior2==LOW){
    contador--;
  }


  if (contador==0){
    if(WiFi.status() != WL_CONNECTED){
        display.clearDisplay();
  // Tamaño del texto
     display.drawBitmap(32,0, nowifi, 64, 64, SSD1306_WHITE);
  // Enviar a pantalla
      display.display();
    }
    else {
 display.clearDisplay();
  // Tamaño del texto
     display.drawBitmap(32,0, wifi, 64, 64, SSD1306_WHITE);
  // Enviar a pantalla
      display.display();
    }
  }
  else if (contador==1){
    // Serial.println(contador);
     display.clearDisplay();
     display.setTextSize(1);
     // Color del texto
     display.setTextColor(SSD1306_WHITE);
     // Posición del texto
     
      display.setCursor(5, 32);
      display.print("Temperatura:");
      display.print(Temperature);
      display.print((char)247);
      display.println("C");
      display.display();
     
  }
  else if (contador==2){
    // Serial.println(contador);
     display.clearDisplay();
     display.setTextSize(1);
     // Color del texto
     display.setTextColor(SSD1306_WHITE);
     // Posición del texto
     
      display.setCursor(5, 32);
      display.print("Humedad:");
      display.print(Humidity);
      display.println("%");
      display.display();
      
  }

  else if (contador==3){
    // Serial.println(contador);
     display.clearDisplay();
     display.setTextSize(1);
     // Color del texto
     display.setTextColor(SSD1306_WHITE);
     // Posición del texto
     
      display.setCursor(5, 32);
      display.print("Temp interna:");
      display.print(temperatura);
      display.print((char)247);
      display.println("C");
      display.display();
      
  }
  //CO2
  else if (contador==4){
    // Serial.println(contador);
     display.clearDisplay();
     display.setTextSize(1);
     // Color del texto
     display.setTextColor(SSD1306_WHITE);
     // Posición del texto
     
      display.setCursor(5, 32);
      display.print("CO2: ");
      display.print(eco2);
      display.println("PPM");
      display.display();
      
  }
  else if(contador>4){
    contador=0;
  }
   else if(contador<0){
    contador=4;
  }
  botonanterior2=boton2;
 
  

   if (temperatura>60){
       digitalWrite(D8,HIGH);
    
     }
     else if (temperatura<35){
       digitalWrite(D8,LOW);
    
     }
  //Serial.println(temperatura);
  if(tiempo2 > (tiempo1+1000)){  //Si ha pasado 1 segundo ejecuta el IF
    tiempo1 = millis(); //Actualiza el tiempo actual
    tiempoSegundos = tiempo1/1000;


  

    /*Serial.print("Ha transcurrido: ");
    Serial.print(tiempoSegundos);
    Serial.println(" desde que se encendio el Arduino");*/
    /*if((tiempoSegundos%60)==0){
      
    }*/
    
    if((tiempoSegundos%300)==0){
      bool chk=dht.read();
      delay(10);
       

       Temperature = dht.readTemperature();         // Leemos la temperatura
       delay(10);
       Humidity = dht.readHumidity();
       delay(10);
       ccs811.read(&eco2,&etvoc,&errstat,&raw);
       delay(10);
       ThingSpeak.setField(1, Temperature);
       ThingSpeak.setField(2, Humidity);
       ThingSpeak.setField(3, eco2);
       ThingSpeak.setField(4, chk);

  Serial.println("si");
  Serial.println(temperatura);
  Serial.println(Temperature);
  Serial.println(Humidity);
  Serial.println(eco2);
  Serial.println(chk);
       contador=0;
       
  
    // subimos los datos a nuestro canal en ThingSpeak
    //200 es el codigo tipico de una transmision OK en el protocolo HTTP
    int x = ThingSpeak.writeFields(myChannelNumber, myWriteAPIKey);
    //int x=1;
    Serial.println(x);
    if(x==200){
     Serial.println("ya mande datos padrino");
    }
    else{
      Serial.println("mamo el mensaje padrino");
      x = ThingSpeak.writeFields(myChannelNumber, myWriteAPIKey);
    //int x=1;
    Serial.println(x);
    if(x==200){
     Serial.println("ya mande datos padrino");
    }
    else{
      Serial.println("mamo otra vez el mensaje padrino");
      x = ThingSpeak.writeFields(myChannelNumber, myWriteAPIKey);
    //int x=1;
    Serial.println(x);
    if(x==200){
     Serial.println("ya mande datos padrino");
    }
    else{
      Serial.println("definitivamente no pudimos enviar el mensaje");
      
    }
    }
    }
  }  
    else if((tiempoSegundos%10)==0){
     contador=0;
    }
    else if((tiempoSegundos%5)==0){
  int valor1 = ThingSpeak.readIntField(myChannelNumber2,1, myReadAPIKey2);
    //Serial.println(valor1);
  
    if (valor1==1){
      delay(16000);
      ThingSpeak.writeField(myChannelNumber2, 1, 0, myWriteAPIKey2);
      ESP.restart();
    }
    }
    
  }
  
  }